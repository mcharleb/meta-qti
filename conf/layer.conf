## conf/layer.conf
```bitbake
# We have a conf and classes directory, add to BBPATH
BBPATH .= ":${LAYERDIR}"

# We have recipes-* directories, add to BBFILES
BBFILES += "${LAYERDIR}/recipes-*/*/*.bb \
	${LAYERDIR}/recipes-*/*/*.bbappend"

BBFILE_COLLECTIONS += "qti"
BBFILE_PATTERN_qti= "^${LAYERDIR}/"
BBFILE_PRIORITY_qti= "6"

# Add our custom license directory
LICENSE_PATH += "${LAYERDIR}/files/qcom-licenses"
```
